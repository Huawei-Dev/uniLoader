## configs/everest_defconfig
```kconfig
CONFIG_KIRIN980=y
CONFIG_HUAWEI_EVEREST=y

# CONFIG_POSITION_INDEPENDENT is not set
CONFIG_LINUX_KRNL_HEADER_IMG=y

CONFIG_TEXT_BASE=0x00080000
CONFIG_PAYLOAD_ENTRY=0x100080000

CONFIG_EMBED_LINUX=y
CONFIG_KERNEL_PATH="blob/Image"
CONFIG_DT_PATH="blob/dtb"

CONFIG_RAMDISK_NO_COPY=y
# CONFIG_LIBFDT is not set

CONFIG_COMPRESS_GZIP=y
# CONFIG_COMPRESS_LZ4 is not set
CONFIG_RAMDISK_ENTRY=0x0
CONFIG_WATCHDOG=y
CONFIG_WDT_SP805=y
CONFIG_WDT_DISABLE_ON_BOOT=y
```
